/*
 * uC Interface - A GUI for Programming & Interfacing with Microcontrollers
 * Copyright (C) 2018  Mitchell Oleson
 *
 * This program is free software: you can redistribute it and/or modify
 * it under the terms of the GNU General Public License as published by
 * the Free Software Foundation, either version 3 of the License, or
 * (at your option) any later version.
 *
 * This program is distributed in the hope that it will be useful,
 * but WITHOUT ANY WARRANTY; without even the implied warranty of
 * MERCHANTABILITY or FITNESS FOR A PARTICULAR PURPOSE.  See the
 * GNU General Public License for more details.
 *
 * You should have received a copy of the GNU General Public License
 * along with this program.  If not, see <https://www.gnu.org/licenses/>.
*/

#include "crc-calcs.h"

// Reverse = TRUE for both LUT and polynomials

#if defined(__crc_LUT)
// Lookup table method (define tables)
#if defined(__crc_8)
// Define lookup table as CRC8
static const uint8_t crc_table[256] =
{
    0x00, 0x91, 0xE3, 0x72, 0x07, 0x96, 0xE4, 0x75,
    0x0E, 0x9F, 0xED, 0x7C, 0x09, 0x98, 0xEA, 0x7B,
    0x1C, 0x8D, 0xFF, 0x6E, 0x1B, 0x8A, 0xF8, 0x69,
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    0xBA, 0x2B, 0x59, 0xC8, 0xBD, 0x2C, 0x5E, 0xCF
};

#elif defined(__crc_16)
// Define lookup table as CRC16
static const uint16_t crc_table[256] = {
    0x0000, 0x1189, 0x2312, 0x329B, 0x4624, 0x57AD,
    0x6536, 0x74BF, 0x8C48, 0x9DC1, 0xAF5A, 0xBED3,
    0xCA6C, 0xDBE5, 0xE97E, 0xF8F7, 0x1081, 0x0108,
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    0x3DE3, 0x2C6A, 0x1EF1, 0x0F78
};

#elif defined(__crc_32)
// Define lookup table as CRC32
static const uint32_t crc_table[256] = {
    0x00000000, 0xF26B8303, 0xE13B70F7, 0x1350F3F4,
    0xC79A971F, 0x35F1141C, 0x26A1E7E8, 0xD4CA64EB,
    0x8AD958CF, 0x78B2DBCC, 0x6BE22838, 0x9989AB3B,
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    0xBE2DA0A5, 0x4C4623A6, 0x5F16D052, 0xAD7D5351
};

#endif

// Define get_crc based on lookup table
crc_t get_crc(const uint8_t *data_array, uint32_t data_len, crc_t crc_start)
{
    const uint8_t *data_p = data_array;

    while (data_len--)
    {
        crc_start = crc_table[(crc_start ^ *data_p++) & __crc_LUT_MAX] ^ (crc_start >> 8);
    }

    return crc_start;
}

#else
// Define poly for use
#if defined(__crc_8)
// Reverse of poly 0x07
static const uint8_t crc_poly = 0xE0;

#elif defined(__crc_16)
// Reverse of poly 0x1021
static const uint16_t crc_poly = 0x8408;

#elif defined(__crc_32)
// Reverse of poly 0x1EDC6F41
static const uint32_t crc_poly = 0x105EC76F;

#endif

// Define get_crc based on CPU calcs
crc_t get_crc(const uint8_t *data_array, uint32_t data_len, crc_t crc_start)
{
    uint8_t i;
    const uint8_t *data_p = data_array;

    while (data_len--)
    {
        crc_start ^= *data_p++;
        for (i = 0; i < 8; i++)
        {
            if (crc_start & 0x1)
                crc_start ^= crc_poly;
            crc_start >>= 1;
        }
    }

    return crc_start;
}

#endif

// Build byte array from CRC (length change with type)
void build_byte_array(crc_t crc, uint8_t* data_array)
{
    // Add each byte to array
    uint8_t i = crc_size;
    do
    {
        i -= 1;
        data_array[i] = (uint8_t) (crc & 0xFF);
        crc = crc >> 8;
    } while (0 < i);
}

crc_t build_crc(const uint8_t *data_array)
{
    // Init holder variable
    crc_t crc = 0;

    // Add each byte to array
    uint8_t i = crc_size;
    do
    {
        i -= 1;
        crc = ((crc << 8) | data_array[i]);
    } while (0 < i);

    // Return the built crc
    return crc;
}

// Check CRC unchanged based on CRC type
bool check_crc(const uint8_t* data_array, uint32_t data_len, crc_t crc_cmp, crc_t crc_start)
{
    return (get_crc(data_array, data_len, crc_start) == crc_cmp);
}
